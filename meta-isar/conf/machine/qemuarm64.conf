## meta-isar/conf/machine/qemuarm64.conf
```bitbake
# This software is a part of ISAR.
# Copyright (C) 2015-2017 ilbers GmbH

DISTRO_ARCH ?= "arm64"

KERNEL_NAME ?= "arm64"
KERNEL_NAME_ubuntu-focal ?= "generic"

IMAGE_TYPE ?= "wic-img"
WKS_FILE ?= "sdimage-efi"
IMAGER_INSTALL += "${GRUB_BOOTLOADER_INSTALL}"

QEMU_ARCH ?= "aarch64"
QEMU_MACHINE ?= "virt"
QEMU_CPU ?= "cortex-a57"
QEMU_DISK_ARGS ?= "-drive file=##ROOTFS_IMAGE##,if=none,format=raw,id=hd0 -device virtio-blk-device,drive=hd0 -pflash ~/.cache/isar-tests/QEMU_EFI.img"

MACHINE_SERIAL ?= "ttyAMA0"
BAUDRATE_TTY ?= "115200"
```
